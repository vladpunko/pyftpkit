## docker/meta-pyftpkit/conf/layer.conf
```bitbake
# -*- coding: utf-8 -*-

# Created by: Vladislav Punko <iam.vlad.punko@gmail.com>
# Created date: 2025-11-01

BBPATH .= ":${LAYERDIR}"

BBFILES += "${LAYERDIR}/recipes/*/*.bbappend \
            ${LAYERDIR}/recipes/*/*.bb"

BBFILE_COLLECTIONS += "meta-pyftpkit"
BBFILE_PATTERN_meta-pyftpkit = "^${LAYERDIR}/"
BBFILE_PRIORITY_meta-pyftpkit = "6"

LAYERDEPENDS_meta-pyftpkit = "core"
LAYERSERIES_COMPAT_meta-pyftpkit = "scarthgap"
```
